## sdkconfig.defaults
```kconfig
# Core settings
CONFIG_FREERTOS_HZ=1000

# Flash 및 PSRAM 활성화
CONFIG_ESPTOOLPY_FLASHSIZE_16MB=y
CONFIG_ESPTOOLPY_FLASHSIZE="16MB"
CONFIG_SPIRAM=y
CONFIG_SPIRAM_MODE_OCT=y

# Arduino 코어를 컴포넌트로 쓸 때 필요한 스택 크기 최적화
CONFIG_ARDUINO_LOOP_STACK_SIZE=8192
```
